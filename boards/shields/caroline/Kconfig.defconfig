## boards/shields/caroline/Kconfig.defconfig
```kconfig
# Copyright (c) 2026 carrefinho
# SPDX-License-Identifier: MIT

if SHIELD_CAROLINE

config ZMK_KEYBOARD_NAME
    default "Caroline"

endif
```

## boards/shields/caroline/Kconfig.shield
```kconfig
# Copyright (c) 2026 carrefinho
# SPDX-License-Identifier: MIT

config SHIELD_CAROLINE
    def_bool $(shields_list_contains,caroline)
```
